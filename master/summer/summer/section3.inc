
<div class="section">

<div class="pageitem">
<h2>Get Social</h2>
</div>

<div class="pageitem">
    <div class="col">
    <a href="#"><img src="fa.png">
    <p>Visit</p>We are on Facebook<br>facebook.com/foo-template</a>
    </div>
    <div class="col">
    <a href="#"><img src="tw.png">
    <p>Follow</p>We are on Twitter<br>twitter.com/foo-template</a>
    </div>
    <div class="col">
    <a href="#"><img src="in.png">
    <p>Like</p>We are on Instagram<br>instagram.com/foo-template</a>
    </div>
    <div class="col">
    <a href="#"><img src="go.png">
    <p>+1</p>We are on Google+<br>plus.google.com/foo-template</a>
    </div>
</div>

</div>