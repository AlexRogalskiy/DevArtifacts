
<div id="menu">
<nav>
<label for="show-menu" class="responsive">&#9776;</label>
<input type="checkbox" id="show-menu" role="button">
<ul id="topnav">
<li><span class="icon"><a href="#" title="Your Logo" class="logo">&#x1F47d;</a></span></li>
<li><a href="#">Profile</a></li>
<li><a href="#">Gallery</a></li>
<li><a href="#">Archive</a></li>
<li><a href="#">Links</a></li>
<li><a href="#">Help</a></li>
<li><span class="icon"><a href="#" class="search">&#x1f50d;</a></span></li>
</ul>
<span class="hide"><a href="#" title="Your Logo" class="logo">&#x1F47d;</a></span>
<span class="hide"><a href="#" class="search">&#x1F50d;</a></span>
</nav>
</div>
<div id="container">